#include "ssd1306.h"

static I2C_HandleTypeDef *ssd1306_i2c;
static uint8_t SSD1306_Buffer[SSD1306_WIDTH * SSD1306_HEIGHT / 8];
static uint16_t cursor_x = 0, cursor_y = 0;

// 5x7 font, ASCII 32 (' ') to 90 ('Z') -- covers uppercase, digits, space, ':', '%', '!'
static const uint8_t font5x7[][5] = {
  {0x00,0x00,0x00,0x00,0x00}, // 32 ' '
  {0x00,0x00,0x5F,0x00,0x00}, // 33 '!'
  {0x00,0x07,0x00,0x07,0x00}, // 34 '"'
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  {0x61,0x51,0x49,0x45,0x43}, // 90 'Z'
};
static uint8_t SSD1306_WriteCommand(uint8_t cmd) {
    HAL_StatusTypeDef status = HAL_I2C_Mem_Write(ssd1306_i2c, SSD1306_I2C_ADDR, 0x00, 1, &cmd, 1, 100);
    return (status == HAL_OK);
}
void SSD1306_Init(I2C_HandleTypeDef *hi2c) {
    ssd1306_i2c = hi2c;
    HAL_Delay(200);
    uint8_t init_cmds[] = {
        0xAE, 0x20, 0x00, 0xB0, 0xC8, 0x00, 0x10, 0x40,
        0x81, 0xFF, 0xA1, 0xA6, 0xA8, 0x3F, 0xA4,
        0xD3, 0x00, 0xD5, 0xF0, 0xD9, 0x22, 0xDA, 0x12,
        0xDB, 0x20, 0x8D, 0x14, 0xAF
    };
    for (uint8_t i = 0; i < sizeof(init_cmds); i++) {
        if (!SSD1306_WriteCommand(init_cmds[i])) {
            while (1) {
                HAL_GPIO_TogglePin(GPIOC, GPIO_PIN_13);
                HAL_Delay(100);
            }
        }
    }
    SSD1306_Clear();
    SSD1306_UpdateScreen();
}
void SSD1306_Clear(void) {
    memset(SSD1306_Buffer, 0x00, sizeof(SSD1306_Buffer));
    cursor_x = 0; cursor_y = 0;
}

void SSD1306_UpdateScreen(void) {
    for (uint8_t page = 0; page < 8; page++) {
        SSD1306_WriteCommand(0xB0 + page);
        SSD1306_WriteCommand(0x00);
        SSD1306_WriteCommand(0x10);
        HAL_I2C_Mem_Write(ssd1306_i2c, SSD1306_I2C_ADDR, 0x40, 1,
                           &SSD1306_Buffer[SSD1306_WIDTH * page], SSD1306_WIDTH, HAL_MAX_DELAY);
    }
}

void SSD1306_SetCursor(uint8_t x, uint8_t y) { cursor_x = x; cursor_y = y; }

void SSD1306_WriteChar(char ch) {
    if (ch < 32 || ch > 90) ch = ' ';
    const uint8_t *glyph = font5x7[ch - 32];
    if (cursor_x + 6 > SSD1306_WIDTH) { cursor_x = 0; cursor_y += 8; }
    if (cursor_y + 8 > SSD1306_HEIGHT) return;
    for (uint8_t col = 0; col < 5; col++) {
        uint8_t line = glyph[col];
        for (uint8_t row = 0; row < 8; row++) {
            if (line & (1 << row))
                SSD1306_Buffer[cursor_x + col + (cursor_y / 8) * SSD1306_WIDTH] |= (1 << row);
        }
    }
    cursor_x += 6;
}

void SSD1306_WriteString(const char *str) { while (*str) SSD1306_WriteChar(*str++); }
